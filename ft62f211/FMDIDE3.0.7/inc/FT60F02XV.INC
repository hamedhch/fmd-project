;==========================================================================
;
;       Register Definitions
;
;==========================================================================
W                EQU  H'0000' 
F                EQU  H'0001'
R                EQU  H'0001'				
;----- Register Files -----------------------------------------------------
;-----Bank0------------------
INDF             EQU  H'0000'
TMR0             EQU  H'0001'
PCL              EQU  H'0002'
STATUS           EQU  H'0003'
FSR              EQU  H'0004'
PORTA            EQU  H'0005'
PORTC			       EQU  H'0007'
PCLATH           EQU  H'000A'
INTCON           EQU  H'000B'
PIR1             EQU  H'000C'
TMR1L            EQU  H'000E'
TMR1H            EQU  H'000F'
T1CON            EQU  H'0010'
TMR2             EQU  H'0011'
T2CON            EQU  H'0012'
EPWMR1L          EQU  H'0013'
EPWMR1H          EQU  H'0014'
EPWM1CON         EQU  H'0015'
PWM1CON          EQU  H'0016'
EPWMAS           EQU  H'0017'
WDTCON           EQU  H'0018'
MSCKCON          EQU  H'001B'
SOSCPRL          EQU  H'001C'
SOSCPRH          EQU  H'001D'
;-----Bank1------------------
OPTION_REG       EQU  H'0081'
OPTION      	 	 EQU  H'0081'
TRISA            EQU  H'0085'
TRISC            EQU  H'0087'
WPUC             EQU  H'0088'
WPD              EQU  H'0089'
PIE1             EQU  H'008C'
PCON             EQU  H'008E'
OSCCON           EQU  H'008F'
EPWM1AUX          EQU  H'0090'
PR2              EQU  H'0092'
WPUA             EQU  H'0095'
IOC              EQU  H'0096'
IOCA             EQU  H'0096'
EEDAT            EQU  H'009A'
EEDATA           EQU  H'009A'
EEADR            EQU  H'009B'
EECON1           EQU  H'009C'
EECON2           EQU  H'009D'
;-----Bank2------------------


;-----Bank0------------------
;----- STATUS Bits -----------------------------------------------------
C                EQU  H'0000'
DC               EQU  H'0001'
HC				 			 EQU  H'0001'
Z                EQU  H'0002'
PF               EQU  H'0003'
NOT_PD           EQU  H'0003'
TF               EQU  H'0004'
NOT_TO           EQU  H'0004'
PAGE0			 			 EQU  H'0005'
RP0              EQU  H'0005'
PAGE1			 			 EQU  H'0006'
RP1				 			 EQU  H'0006'
FSR_B8			 		 EQU  H'0007'
;----- PORTA Bits -----------------------------------------------------
RA0              EQU  H'0000'
PA0              EQU  H'0000'
RA1              EQU  H'0001'
PA1              EQU  H'0001'
RA2              EQU  H'0002'
PA2              EQU  H'0002'
RA3              EQU  H'0003'
PA3              EQU  H'0003'
RA4              EQU  H'0004'
PA4              EQU  H'0004'
RA6              EQU  H'0006'
PA6              EQU  H'0006'
RA7              EQU  H'0007'
PA7              EQU  H'0007'
;----- PORTC Bits -----------------------------------------------------
RC0              EQU  H'0000'
PC0              EQU  H'0000'
RC1              EQU  H'0001'
PC1              EQU  H'0001'
RC2              EQU  H'0002'
PC2              EQU  H'0002'
RC3              EQU  H'0003'
PC3              EQU  H'0003'
RC4              EQU  H'0004'
PC4              EQU  H'0004'
;----- INTCON Bits -----------------------------------------------------
RAIF             EQU  H'0000'
PAIF             EQU  H'0000'
INTF             EQU  H'0001'
T0IF             EQU  H'0002'
TMR0IF           EQU  H'0002'
RAIE             EQU  H'0003'
PAIE             EQU  H'0003'
INTE             EQU  H'0004'
T0IE             EQU  H'0005'
TMR0IE           EQU  H'0005'
PEIE             EQU  H'0006'
GIE              EQU  H'0007'
;----- PIR1 Bits -----------------------------------------------------
TMR1IF           EQU  H'0000'
T1IF             EQU  H'0000'
TMR2IF           EQU  H'0001'
T2IF             EQU  H'0001'
CKMEAIF          EQU  H'0006'
EEIF             EQU  H'0007'
;----- T1CON Bits -----------------------------------------------------
TMR1ON           EQU  H'0000'
TMR1CS           EQU  H'0001'
T1SYNC           EQU  H'0002'
T1CKPS0          EQU  H'0004'
T1CKPS1          EQU  H'0005'
TMR1GE           EQU  H'0006'
T1GINV           EQU  H'0007'
;----- T2CON Bits -----------------------------------------------------
T2CKPS0          EQU  H'0000'
T2CKPS1          EQU  H'0001'
TMR2ON           EQU  H'0002'
TOUTPS0          EQU  H'0003'
TOUTPS1          EQU  H'0004'
TOUTPS2          EQU  H'0005'
TOUTPS3          EQU  H'0006'
;----- EPWM1CON Bits -----------------------------------------------------
EPWM1M0           EQU  H'0000'
EPWM1M1           EQU  H'0001'
EPWM1M2           EQU  H'0002'
EPWM1M3           EQU  H'0003'
DC1B0            EQU  H'0004'
DC1B1            EQU  H'0005'
P1M0             EQU  H'0006'
P1M1             EQU  H'0007'
;----- PWM1CON Bits -----------------------------------------------------
PDC0             EQU  H'0000'
PDC1             EQU  H'0001'
PDC2             EQU  H'0002'
PDC3             EQU  H'0003'
PDC4             EQU  H'0004'
PDC5             EQU  H'0005'
PDC6             EQU  H'0006'
PRSEN            EQU  H'0007'
;----- EPWMAS Bits -----------------------------------------------------
EPWMAS0          EQU  H'0004'
EPWMAS1          EQU  H'0005'
EPWMAS2          EQU  H'0006'
EPWMASE          EQU  H'0007'
;----- WDTCON Bits -----------------------------------------------------
SWDTEN           EQU  H'0000'
WDTPS0           EQU  H'0001'
WDTPS1           EQU  H'0002'
WDTPS2           EQU  H'0003'
WDTPS3           EQU  H'0004'
;----- MSCKCON Bits -----------------------------------------------------
CKCNTI           EQU  H'0001'
CKMAVG           EQU  H'0002'
SLVREN			 		 EQU  H'0004'
T2CKSRC			 		 EQU  H'0005'
;-----Bank1------------------
;----- OPTION_REG Bits -----------------------------------------------------
PS0              EQU  H'0000'
PS1              EQU  H'0001'
PS2              EQU  H'0002'
PSA              EQU  H'0003'
T0SE             EQU  H'0004'
T0CS             EQU  H'0005'
INTEDG           EQU  H'0006'
PAPU			 			 EQU  H'0007'
NOT_PAPU         EQU  H'0007'
NOT_RAPU         EQU  H'0007'
;----- TRISA Bits -----------------------------------------------------
TRISA0           EQU  H'0000'
TRISA1           EQU  H'0001'
TRISA2           EQU  H'0002'
TRISA3           EQU  H'0003'
TRISA4           EQU  H'0004'
TRISA6           EQU  H'0006'
TRISA7           EQU  H'0007'
;----- TRISC Bits -----------------------------------------------------
TRISC0           EQU  H'0000'
TRISC1           EQU  H'0001'
TRISC2           EQU  H'0002'
TRISC3           EQU  H'0003'
TRISC4           EQU  H'0004'
;----- WPUC Bits -----------------------------------------------------
WPUC0            EQU  H'0000'
WPUC1            EQU  H'0001'
WPUC2            EQU  H'0002'
WPUC3            EQU  H'0003'
WPUC4            EQU  H'0004'
;----- WPD Bits -----------------------------------------------------
WPDC3            EQU  H'0001'
WPDC2            EQU  H'0002'
WPDC1            EQU  H'0003'
WPDA4            EQU  H'0004'
;----- PIE1 Bits -----------------------------------------------------
T1IE             EQU  H'0000'
TMR1IE           EQU  H'0000'
T2IE             EQU  H'0001'
TMR2IE           EQU  H'0001'
CKMEAIE          EQU  H'0006'
EEIE             EQU  H'0007'
;----- PCON Bits -----------------------------------------------------
BOR              EQU  H'0000'
NOT_BOR          EQU  H'0000'
POR              EQU  H'0001'
NOT_POR          EQU  H'0001'
LVDW             EQU  H'0002'
LVDEN            EQU  H'0003'
LVDL0            EQU  H'0004'
LVDL1            EQU  H'0005'
LVDL2            EQU  H'0006'
VREF_OE          EQU  H'0007'
;----- OSCCON Bits -----------------------------------------------------
SCS				 			 EQU  H'0000'
LTS              EQU  H'0001'
LFIOFR			 		 EQU  H'0001'
HTS              EQU  H'0002'
HFIOFR			 		 EQU  H'0002'
IRCF0            EQU  H'0004'
IRCF1            EQU  H'0005'
IRCF2            EQU  H'0006'
LFMOD			 EQU  H'0007'
LFOMOD			 EQU  H'0007'
;----- EPWM1AUX Bits -----------------------------------------------------
P1COE            EQU  H'0002'
P1DOE			 		   EQU  H'0003'
P1EOE            EQU  H'0004'
P1FOE            EQU  H'0005'
P1OS             EQU  H'0006'
AUX1EN			 		 EQU  H'0007'
;----- WPUA Bits -----------------------------------------------------
WPUA0            EQU  H'0000'
WPUA1            EQU  H'0001'
WPUA2            EQU  H'0002'
WPUA3            EQU  H'0003'
WPUA4            EQU  H'0004'
WPUA6            EQU  H'0006'
WPUA7            EQU  H'0007'
WPU0             EQU  H'0000'
WPU1             EQU  H'0001'
WPU2             EQU  H'0002'
WPU3             EQU  H'0003'
WPU4             EQU  H'0004'
WPU6             EQU  H'0006'
WPU7             EQU  H'0007'
;----- IOCA Bits -----------------------------------------------------
IOCA0            EQU  H'0000'
IOCA1            EQU  H'0001'
IOCA2            EQU  H'0002'
IOCA3            EQU  H'0003'
IOCA4            EQU  H'0004'
IOCA6            EQU  H'0006'
IOCA7            EQU  H'0007'
IOC0             EQU  H'0000'
IOC1             EQU  H'0001'
IOC2             EQU  H'0002'
IOC3             EQU  H'0003'
IOC4             EQU  H'0004'
IOC6             EQU  H'0006'
IOC7             EQU  H'0007'
;----- EECON1 Bits -----------------------------------------------------
RD               EQU  H'0000'
WREN1			 			 EQU  H'0002'
WRERR            EQU  H'0003'
WREN2			 			 EQU  H'0004'
WREN3			 			 EQU  H'0005'
;----- EECON2 Bits -----------------------------------------------------
WR               EQU  H'0000'
;-----Bank2------------------
        LIST
