//********************************************************* 
/* 文件名：TEST_FT62F21x_INT.c
* 功能：   FT62F21x-INT功能演示
* IC:	   FT62F211 SOP8
* 晶振：   16M/4T                    
* 说明：   程序中DemoPortOut(PA4)输出100帧50HZ的占空比为50%的方波后, 
*		   MCU进入睡眠, 等待外部中断的发生; 当外部中断触发后，重复以上流程;
*
*                     FT62F211 SOP8 
*                    ----------------
*  DemoPortOut-----|1(PA4)     (PA3)8|------------NC    
*  NC--------------|2(TKCAP)   (PA0)7|------------NC
*  VDD-------------|3(VDD)     (PA1)6|------------NC
*  GND-------------|4(VSS)     (PA2)5|-----------INT
*			         ----------------
*/
//*********************************************************
#include	"SYSCFG.h";
#include 	"FT62F21X.h";
//***********************宏定义****************************
#define  unchar     	unsigned char 
#define  DemoPortOut	PA4   
 
unchar 	FCount;
/*-------------------------------------------------
 * 函数名：interrupt ISR
 * 功能：  PA2外部中断处理
 * 输入：  无
 * 输出：  无
 --------------------------------------------------*/
void interrupt ISR(void)
{ 
	if(INTE && INTF)	
	{
		INTF = 0;  				//清PA2 INT 标志位
		INTE = 0;  				//暂先禁止PA2中断
	}
}
 /*-------------------------------------------------
 * 函数名：POWER_INITIAL
 * 功能：  上电系统初始化
 * 输入：  无
 * 输出：  无
 --------------------------------------------------*/	
void POWER_INITIAL (void) 
{
	OSCCON = 0B01110000;		//IRCF=111=16MHz/4=4MHz,0.25us
	INTCON = 0;  				//暂禁止所有中断

	PORTA = 0B00000000;				
	TRISA = 0B00000100;			//PA输入输出 0-输出 1-输入  PA2输入
	WPUA = 0B00000100;     		//PA端口上拉控制 1-开上拉 0-关上拉

	OPTION = 0B01001000;		//Bit3=1 WDT MODE,PS=000=1:1 WDT RATE
	MSCON = 0B00000000;		                             
}
 /*-------------------------------------------------
 * 函数名：DelayUs
 * 功能：  短延时函数 --16M-4T--大概快1%左右.
 * 输入：  Time 延时时间长度 延时时长Time*2 Us
 * 输出：  无 
 -------------------------------------------------*/
void DelayUs(unsigned char Time)
{
	unsigned char a;
	for(a=0;a<Time;a++)
	{
		NOP();
	}
}                  
/*------------------------------------------------- 
 * 函数名：DelayMs
 * 功能：  短延时函数 快1%
 * 输入：  Time 延时时间长度 延时时长Time ms
 * 输出：  无 
 -------------------------------------------------*/
void DelayMs(unsigned char Time)
{
	unsigned char a,b;
	for(a=0;a<Time;a++)
	{
		for(b=0;b<5;b++)
		{
		 	DelayUs(98);               
		}
	}
}
/*-------------------------------------------------
 * 函数名: INT_INITIAL 
 * 功能：  中断初始化函数
 * 输入：  无
 * 输出：  无
 --------------------------------------------------*/
void INT_INITIAL(void)
{
	TRISA2 =1; 					//SET PA2 INPUT
	INTEDG = 1; 				//OPTION,INTEDG=1;PA2 INT 为上升沿触发 
	INTF =0;   					//清PA2 INT中断标志位
	INTE =1;   					//使能PA2 INT中断
}
/*-------------------------------------------------
 * 函数名：main 
 * 功能：  主函数
 * 输入：  无
 * 输出：  无
 --------------------------------------------------*/
void main()
{
	POWER_INITIAL();			//系统初始化
	while(1)
	{
		for(FCount=0;FCount<100;FCount++)//输出100次波形	
		{
			DemoPortOut = 1; 		
			DelayMs(10);  		//10ms 
			DemoPortOut = 0;
			DelayMs(10); 
		}
		INT_INITIAL();			//初始化外部中断
		GIE = 1;				//开总中断
		SLEEP();				//睡眠
	}
}