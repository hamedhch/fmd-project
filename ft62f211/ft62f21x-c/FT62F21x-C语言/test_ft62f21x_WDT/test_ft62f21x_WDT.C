//********************************************************* 
/* 文件名：Test_62F21X_WDT.c
* 功能：   FT62F21X_WDT功能演示
* IC:      FT62F211 SOP8 
* 晶振：   16M/4T                    
* 说明：   程序中开启看门狗并将看门狗时间设置为32ms
*		   a. 主函数先在DemoPortOut脚输出一个高3ms低3ms的信号，
*		   b. 然后循环输出高1ms低1ms，500HZ的信号。
*		   如果不在主程序中清看门狗，则每隔32ms单片机复位后，会重复输出a+b信号；
*		   如果在主函数中清看门狗，则一直输出b信号
*
*                  	FT62F211 SOP8 
*                 ----------------
*  DemoPortOut---|1(PA4)   (PA3)8|-------------NC 
*  NC------------|2(TKCAP) (PA0)7|-------------NC
*  NC------------|3(VDD)   (PA1)6|-------------NC 
*  NC------------|4(VSS)   (PA2)5|-------------NC
*			      ----------------
*/
//********************************************************* 
#include	"SYSCFG.h";
#include 	"FT62F21X.h";

#define  DemoPortOut	PA4  
/*-------------------------------------------------
 * 函数名：POWER_INITIAL
 * 功能：  上电系统初始化
 * 输入：  无
 * 输出：  无
 --------------------------------------------------*/	
void POWER_INITIAL (void) 
{ 
	OSCCON = 0B01110000;	//16MHz 1:1
	INTCON = 0B00000000;  	//暂禁止所有中断
	
    TRISA = 0B00000000;		//1:输入 0:输出 PA4输出模式
    PSRCA = 0B00000000;
    //00:	 3mA
    //01/10: 6mA 
    //11:	 24mA 
    //Bit[3:2]控制PA5源电流 
    //Bit[1:0]控制PA4源电流
    
    PSINKA = 0B00000000;	//Bit[1:0] 控制PA5和PA4 0:灌电流最小 1:灌电流最大
    PORTA = 0B00000000;		//1:PAx输出高电平 0:PAx输出低电
 	WPUA = 0B00000000;		//1:使能PA口上拉  0:关闭PA口上拉   
}
/*-------------------------------------------------
 * 函数名：DelayUs
 * 功能：  短延时函数 --16M-4T--大概快1%左右.
 * 输入：  Time 延时时间长度 延时时长Time*2Us
 * 输出：  无 
 -------------------------------------------------*/
void DelayUs(unsigned char Time)
{
	unsigned char a;
	for(a=0;a<Time;a++)
	{
		NOP();
	}
}                  
/*------------------------------------------------- 
 *函数名：DelayMs
 *功能：  短延时函数
 *输入：  Time 延时时间长度 延时时长Time ms
 *输出：  无 
 -------------------------------------------------*/
void DelayMs(unsigned char Time)
{
	unsigned char a,b;
	for(a=0;a<Time;a++)
	{
		for(b=0;b<5;b++)
		{
		 	DelayUs(98); //快1%
		}
	}
}
/*-------------------------------------------------
 * 函数名：WDT_INITIAL
 * 功能：  初始化设置看门狗32ms时间复位
 * 说明：  wdt溢出时间 = (1/32000)*16位预分频值*8位预分频值 
 * 			= (1/32kHz)*1024*1 = 32ms
 -------------------------------------------------*/
void WDT_INITIAL (void) 
{
    CLRWDT();  					//清看门狗
	WDTCON = (0X05<<1)| (1<<0);	
    //Bit5: 	0:LIRC 1:HIRC
    //Bit[4:1]: 0X05 1:1024
    //Bit0:		1:使能 WDT
	OPTION = 0;
    PSA = 1;					//预分频分配位	1：WDT	0: Timer0(option)
}
/*-------------------------------------------------
 * 函数名: main 
 * 功能： 主函数
 * 输入：  无
 * 输出：  无
 --------------------------------------------------*/
void main()
{
	POWER_INITIAL();			//系统初始化
	WDT_INITIAL();				//看门狗初始化
    
	DemoPortOut = 1; 		
	DelayMs(3);     			//3ms
	DemoPortOut = 0;
	DelayMs(3); 				//3ms
    
	while(1)
	{
	 	//CLRWDT(); 			//清看门狗
		DemoPortOut = 1; 	
		DelayMs(1);     		//1ms
		DemoPortOut = 0; 
		DelayMs(1); 			//1ms
	}    
}
